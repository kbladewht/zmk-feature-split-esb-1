## Kconfig
```kconfig
# Copyright 2026 Roman Kuzmitskii (@damex)
# SPDX-License-Identifier: MIT

menuconfig ZMK_SPLIT_ESB
    bool "ZMK ESB split transport"
    depends on ZMK_SPLIT && ZMK_SPLIT_ROLE_CENTRAL
    select ESB
    help
      Central-side Enhanced ShockBurst (2.4 GHz) split transport for one or more
      peripherals. One ESB packet carries one complete split message.
      ESB hardware ACK, retransmit and CRC provide reliability.

if ZMK_SPLIT_ESB

config ZMK_SPLIT_ESB_MAX_PAYLOAD
    int "Max on-air payload bytes"
    default 48
    help
      Must be >= the largest split message struct. A build assert checks this.

config ZMK_SPLIT_ESB_RX_QUEUE_SIZE
    int "Received-packet ring depth (power of 2)"
    default 16
    help
      Lock-free SPSC ring between the radio ISR and the dispatch thread. Must be
      a power of 2. Deep enough to ride out dispatch stalls at the RX rate.

config ZMK_SPLIT_ESB_EVENT_QUEUE_SIZE
    int "Central: behavior-bound event queue depth"
    default 16
    help
      Key, sensor and battery events queue here for the system workqueue,
      where ZMK behavior state lives. Input events bypass this queue.

config ZMK_SPLIT_ESB_PRIORITY
    int "Split transport registration priority"
    default 50

config ZMK_SPLIT_ESB_BATTERY_LOG
    bool "Log peripheral battery changes on the central"
    help
      Battery level changes to the central log, one line per percent step.
      Diagnostic only, needs a log backend.

config ZMK_SPLIT_ESB_HID_RELAY
    bool "Relay HID reports across the ESB link"
    help
      Central snoops HID reports and sends each one to relay-role peripherals.

config ZMK_SPLIT_ESB_HID_RELAY_POLL_MS
    int "Relay peripheral poll period, ms"
    default 4
    depends on ZMK_SPLIT_ESB_HID_RELAY
    help
      Poll period used by relay peripherals. Keep this in sync with their firmware.

config ZMK_SPLIT_ESB_HID_RELAY_KEEPALIVE_MS
    int "HID relay keepalive period, ms"
    default 4
    depends on ZMK_SPLIT_ESB_HID_RELAY
    help
      Central re-sends the current HID report at this rate while the relay queue
      is idle, so a rare dropped release report heals within one period.
      Match this to ZMK_SPLIT_ESB_HID_RELAY_POLL_MS so every relay poll has a fresh report.

menuconfig ZMK_SPLIT_ESB_WIRE
    bool "Wire link between split peripherals"
    select SERIAL
    select UART_INTERRUPT_DRIVEN
    select RING_BUFFER
    select CRC
    help
      UART link between the central and a split peripheral. Reuses the ESB
      wire packet format above raw framing, with full duplex or simplex mode.

config ZMK_SPLIT_ESB_WIRE_PEER
    bool "Central has a wire peer"
    depends on ZMK_SPLIT_ROLE_CENTRAL
    select ZMK_SPLIT_ESB_WIRE
    help
      Central ingests events and keepalives from split peripheral over wire
      link. Peer pipe named by chosen zmk,esb-wire-peer.

if ZMK_SPLIT_ESB_WIRE

config ZMK_SPLIT_ESB_WIRE_KEEPALIVE_MS
    int "Wire link keepalive period, ms"
    default 100

config ZMK_SPLIT_ESB_WIRE_TIMEOUT_MS
    int "Wire link peer-alive timeout, ms"
    default 500

endif # ZMK_SPLIT_ESB_WIRE

module = ZMK_SPLIT_ESB
module-str = ZMK ESB split transport
source "subsys/logging/Kconfig.template.log_config"

endif # ZMK_SPLIT_ESB
```

## dts/bindings/zmk,split-esb.yaml
```yaml
# Copyright 2026 Roman Kuzmitskii (@damex)
# SPDX-License-Identifier: MIT

description: |
  Shared ESB link configuration for a ZMK ESB split.
  The central and every peripheral must use identical hard-coded radio settings to pair.
  Place this node in a dtsi included by the central and every peripheral.

compatible: "zmk,split-esb"

properties:
  hop-channels:
    type: uint8-array
    description: |
      Candidate RF channel pool, each 0-100 (2400 + N MHz).
      Optional. Default sits above 802.11 channel 11 (ESB 74-83, 2474-2483 MHz), the only
      stretch WiFi 1/6/11 leaves clear even against 40 MHz channels, so the link stays off
      WiFi out of the box. The engine measures the pool from live traffic and masks any
      channel that still performs badly. Set explicitly to use a different band. One channel
      means fixed operation.
    default: [74, 75, 76, 77, 78, 79, 80, 81, 82, 83]
  hop-anchors:
    type: uint8-array
    default: [76, 79, 82]
    description: |
      Rendezvous channels, a subset of hop-channels, kept unmaskable so a lost link always
      re-finds the central on known spectrum. Pick channels clear of local WiFi, since the
      engine can never mask these. Default 76, 79, 82, spread across the clean band above
      WiFi channel 11.
  hop-threshold:
    type: int
    default: 24
    description: |
      Graded loss before acting. A fully-lost window scores 4, so the default tolerates
      five bad windows and hops on the sixth, riding out brief interference instead of
      fleeing it. Central: weighted link-loss sum across peripherals that triggers a
      coordinated hop. Peripheral: sweep trigger for the failed-window streak.
  hop-min-active:
    type: int
    default: 6
    description: |
      Floor on channels the central keeps active. Masking never drops below this, so a
      single interferer can never strand the link without frequency diversity to escape to.
  hop-mask-threshold:
    type: int
    default: 16
    description: |
      Accumulated per-channel bad score at which the central masks a channel out of the hop
      set. Each bad window on the channel adds its graded penalty; each clean window decays it.
      Higher is more patient. Echoes hop-threshold's accumulate-to-a-number shape.
  hop-restore-windows:
    type: int
    default: 64
    description: |
      Base decision windows a masked channel waits before the central re-admits it to retest.
      A masked channel is not measured, so this paces blind retries. A channel that keeps failing
      retest backs off exponentially from this base, so persistent interferers stop pulling the
      live link onto known-bad spectrum every period. Higher thrashes less.
  hop-window-ms:
    type: int
    default: 32
    description: Peripheral keepalive period while data is flowing.
  rssi-floor-dbm:
    type: int
    default: -85
    description: |
      Central hop trigger. A served peripheral whose motion arrives weaker than this (dBm)
      counts the window as degraded, so the link hops toward a better-propagating channel.
      Set near where the link actually fails, or it hops chasing a merely-distant peer.
  idle-keepalive-ms:
    type: int
    default: 128
    description: |
      Peripheral keepalive period when no data is flowing. Also the central's hop-decision
      window period.
  peripheral-timeout-ms:
    type: int
    default: 3000
    description: |
      Central declares a peripheral silent for this long stale and releases its held
      state (keys, input-split buttons), the connectionless equivalent of a disconnect.
      A keepalive from the returning peripheral re-syncs anything still held.
  lossy-codes:
    type: array
    description: |
      Input axes the peripheral sends without ACK.
      Each entry is two cells, an INPUT_EV_* type and its INPUT_*_<NAME> code,
      e.g. <INPUT_EV_REL INPUT_REL_X>, <INPUT_EV_REL INPUT_REL_Y>.
      Reserve for high-rate, self-correcting axes (pointer motion).
      Non-input split events (key-position, sensor, battery) are always ACK'd, and
      every other input event is ACK'd unless listed.
      Omit for fully lossless link.

child-binding:
  description: Peripheral table container.
  child-binding:
    description: One ESB peripheral.
    properties:
      pipe:
        type: int
        required: true
        description: ESB pipe index, also the ZMK source id.
      prefix:
        type: int
        required: true
        description: 1-byte address prefix, distinct per pipe.
      weight:
        type: int
        default: 1
        description: Relative weight in the central's hop vote.
      reply-queue-depth:
        type: int
        default: 8
        description: |
          Central's reverse-channel reply backlog for this peripheral. Raise it for
          one that receives many commands.
```

## tests/mock/common/Kconfig.esb
```kconfig
# Copyright 2026 Roman Kuzmitskii (@damex)
# SPDX-License-Identifier: MIT

# Legacy-shaped size symbols used only by the test radio mock.

config ESB_MAX_PAYLOAD_LENGTH
    int "Maximum payload size"
    default 32
    range 1 252

config ESB_TX_FIFO_SIZE
    int "TX buffer length"
    default 8

config ESB_RX_FIFO_SIZE
    int "RX buffer length"
    default 8

config ESB_PIPE_COUNT
    int "Maximum number of pipes"
    default 8
    range 1 8
```
